## drivers/accessory/mhl/Kconfig
```kconfig
#
# Copyright (c) 2010 Samsung Electronics Co., Ltd.
# 		http://www.samsung.com/
# Woojong Yoo
#	woojong.yoo@samsung.com
# Licensed under GPLv2

config MHL_SII9234
	bool "Samsung Mobile HD Link Interface"
	depends on I2C
	default n
	---help---
	Mobile HD Link Transmitter driver for SiI9234

config MHL_SWITCH
	bool "Samsung Mobile HD Link Switch Interface"
	depends on MHL_SII9234
	default n
	---help---
	Mobile HD Link uses switch
```

## drivers/media/video/tegra/Kconfig
```kconfig
source "drivers/media/video/tegra/avp/Kconfig"
source "drivers/media/video/tegra/mediaserver/Kconfig"
source "drivers/media/video/tegra/nvavp/Kconfig"

config TEGRA_CAMERA
        bool "Enable support for tegra camera/isp hardware"
        depends on ARCH_TEGRA
        default y
        help
          Enables support for the Tegra camera interface

          If unsure, say Y

config TEGRA_DTV
        bool "Enable support for tegra dtv interface"
        depends on ARCH_TEGRA
        default y
        help
          Enables support for the Tegra dtv interface

          If unsure, say Y

config VIDEO_OV5650
        tristate "OV5650 camera sensor support"
        depends on I2C && ARCH_TEGRA
        ---help---
          This is a driver for the Omnivision OV5650 5MP camera sensor
          for use with the tegra isp.

config VIDEO_S5K4ECGX
        tristate "S5K4ECGX camera sensor support"
        depends on I2C && ARCH_TEGRA
        ---help---
          This is a driver for the Samsung Electronics S5K4ECGX 5MP camera sensor
          for use with the tegra isp.

config VIDEO_S5K6AAFX
        tristate "S5K6AAFX camera sensor support"
        depends on I2C && ARCH_TEGRA
        ---help---
          This is a driver for the Partron S5K6AAFX 1.3MP camera sensor
          for use with the tegra isp.

config VIDEO_M5MO
        tristate "M5MO camera sensor support"
        depends on I2C && ARCH_TEGRA
        ---help---
          This is a driver for the Fujitsu M5MO 8MP camera sensor
          for use with the tegra isp.

config VIDEO_OV14810
        tristate "OV14810 camera sensor support"
        depends on I2C && ARCH_TEGRA
        ---help---
          This is a driver for the Omnivision OV14810 14MP camera sensor
          for use with the tegra isp.


config VIDEO_OV9726
        tristate "OV9726 camera sensor support"
        depends on I2C && ARCH_TEGRA
        ---help---
          This is a driver for the Omnivision OV9726 camera sensor
          for use with the tegra isp.

config VIDEO_OV2710
        tristate "OV2710 camera sensor support"
        depends on I2C && ARCH_TEGRA
        ---help---
          This is a driver for the Omnivision OV2710 camera sensor
          for use with the tegra isp.

config VIDEO_AR0832
        tristate "AR0832 camera sensor support"
        depends on I2C && ARCH_TEGRA
        ---help---
          This is a driver for the AR0832 camera sensor
          for use with the tegra isp.

config VIDEO_SOC380
        tristate "SOC380 camera sensor support"
        depends on I2C && ARCH_TEGRA
        ---help---
          This is a driver for the Semco soc380 camera sensor
          for use with the tegra isp.

config TORCH_SSL3250A
        tristate "SSL3250A flash/torch support"
        depends on I2C && ARCH_TEGRA
        ---help---
          This is a driver for the SSL3250A flash/torch camera device

config TORCH_TPS61050
        tristate "TPS61050 flash/torch support"
        depends on I2C && ARCH_TEGRA
        ---help---
          This is a driver for the TPS61050 flash/torch camera device

config VIDEO_SH532U
        tristate "SH532U focuser support"
        depends on I2C && ARCH_TEGRA
        ---help---
          This is a driver for the SEMCO SH532U focuser
          for use with the tegra isp.

config VIDEO_AD5820
        tristate "AD5820 focuser support"
        depends on I2C && ARCH_TEGRA
        ---help---
          This is a driver for the AD5820 focuser
          for use with the tegra isp.

config TEGRA_DYNAMIC_CAMERA_CLK_RATE
        boolean "Set graphics clk rate per use cases"
        depends on CPU_FREQ && ARCH_TEGRA
        ---help---
          Dynamically change the rates of graphics related clocks
          based on the use case that is being executed on the
          camera system. For example, clocks usually set to
          higher rates when switching to higher resolutions.
```

## drivers/sensors/proxlight/Kconfig
```kconfig
#
# PROXIMITY & LIGHT Sensor Configuration
#
config PROXLIGHT
	bool "PROXIMITY & LIGHT Sensor"
	default n
	help
	  This option enables proximity sensors
	  Say Y here if you have proximity sensors.

config SENSORS_CM3663
	tristate "CAPELLA CM3663 ambient light and proximity sensor"
	depends on PROXLIGHT
	help
	  Say Y here if you have CAPELLA CM3663 hooked to an I2C bus.
	  This option eanbles the light & proximity sensor device driver for
	  the CAPELLA CM3663 chip.
```
